## Kconfig
```kconfig
# SPDX-License-Identifier: MIT

config ZMK_BEHAVIOR_TAP_REPEAT
    bool
    default y
    depends on DT_HAS_ZMK_BEHAVIOR_TAP_REPEAT_ENABLED

config ZMK_USB_SPLIT_BATTERY
    bool "Expose split battery levels over a USB HID interface"
    depends on ZMK_USB && ZMK_SPLIT_ROLE_CENTRAL && ZMK_SPLIT_BLE_CENTRAL_BATTERY_LEVEL_FETCHING
    default n
```

## boards/shields/lapka/Kconfig.shield
```kconfig
config SHIELD_LAPKA_LEFT
    def_bool $(shields_list_contains,lapka_left)

config SHIELD_LAPKA_RIGHT
    def_bool $(shields_list_contains,lapka_right)
```

## boards/shields/lapka_wellum36/Kconfig.defconfig
```kconfig
if SHIELD_LAPKA_WELLUM36_DONGLE

config ZMK_KEYBOARD_NAME
	default "Lapka 42"

config ZMK_USB
	default y

config ZMK_STUDIO
  default n

config ZMK_SPLIT_BLE_ROLE_CENTRAL
	default y

config ZMK_SPLIT_BLE_CENTRAL_PERIPHERALS
  default 2

config BT_MAX_CONN
  default 7

config BT_MAX_PAIRED
  default 7

endif

if SHIELD_LAPKA_WELLUM36_LEFT || SHIELD_LAPKA_WELLUM36_RIGHT || SHIELD_LAPKA_WELLUM36_DONGLE

config ZMK_SPLIT
	default y

config ZMK_BLE
	default y

endif
```

## boards/shields/lapka_wellum36/Kconfig.shield
```kconfig
config SHIELD_LAPKA_WELLUM36_LEFT
	def_bool $(shields_list_contains,lapka_wellum36_left)

config SHIELD_LAPKA_WELLUM36_RIGHT
	def_bool $(shields_list_contains,lapka_wellum36_right)

config SHIELD_LAPKA_WELLUM36_DONGLE
	def_bool $(shields_list_contains,lapka_wellum36_dongle)
```

## dts/bindings/behaviors/zmk,behavior-tap-repeat.yaml
```yaml
# SPDX-License-Identifier: MIT
description: |
  Repeatedly taps the bound behavior while the key is held (firmware auto-repeat).

compatible: "zmk,behavior-tap-repeat"

include: zero_param.yaml

properties:
  bindings:
    type: phandle-array
    required: true
  wait-ms:
    type: int
    default: 250
  tap-ms:
    type: int
    default: 100
```
